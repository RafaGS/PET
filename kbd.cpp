#include <Arduino.h>
#include <stdint.h>
#include "inc/machine.h"
#include "inc/ps2_raw_kbd.h"
#include "inc/hardware.h"
#include "inc/debugging.h"
#include "kbd.h"

// http://www.6502.org/users/andre/petindex/keyboards.html
// Teclado gráfico del PET 2001

// Mapa principal (scan code PS/2 → fila/col PET)
static const uint8_t scanmap[128] PROGMEM = {
    0xff, 0xff, 0xff, 0xff, 0xff, 0xff, 0xff, 0xff, // 0x00
    0xff, 0xff, 0xff, 0xff, 0xff, 0xff, 0xff, 0xff, // 0x08
    0xff, 0xff, 0x80, 0xff, 0xff, 0x20, 0x00, 0xff, // 0x10
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    0xff, 0x77, 0x67, 0x87, 0x57, 0x27, 0xff, 0xff, // 0x78
};

// Con R-Shift
static const uint8_t shiftmap[128] PROGMEM = {
    0xff, 0xff, 0xff, 0xff, 0xff, 0xff, 0xff, 0xff, // 0x00
    0xff, 0xff, 0xff, 0xff, 0xff, 0xff, 0xff, 0xff, // 0x08
    0xff, 0xff, 0xff, 0xff, 0xff, 0xff, 0x00, 0xff, // 0x10
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    0xff, 0xff, 0xff, 0xff, 0xff, 0xff, 0xff, 0xff, // 0x78
};

// Con Ctrl
static const uint8_t ctrlmap[128] PROGMEM = {
    0xff, 0xff, 0xff, 0xff, 0xff, 0xff, 0xff, 0xff, // 0x00
    0xff, 0xff, 0xff, 0xff, 0xff, 0xff, 0xff, 0xff, // 0x08
    0xff, 0xff, 0xff, 0xff, 0xff, 0x16, 0xff, 0xff, // 0x10
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    0xff, 0xff, 0xff, 0xff, 0xff, 0xff, 0xff, 0xff, // 0x78
};

uint8_t kbd::_map(uint8_t scan) {
    if (_shift)
        return pgm_read_byte(shiftmap + scan);
    if (_ctrl)
        return pgm_read_byte(ctrlmap + scan);
    return pgm_read_byte(scanmap + scan);
}

void kbd::_reset(uint8_t k) {
    if (k == 0xff || (k >> 4) >= 10) return;
    _rows[k >> 4] &= ~(1 << (k & 0x0f));
}

void kbd::_set(uint8_t k) {
    if (k == 0xff || (k >> 4) >= 10) return;
    _rows[k >> 4] |= 1 << (k & 0x0f);
}

void kbd::up(uint8_t scan) {

    DBG_EMU("key up: %02x", scan);

    if (_ext) {
        _ext = false;
        switch(scan) {
        case 0x69: _reset(0x80); // end (fall-through)
        case 0x6c: _reset(0x06); break; // home
        case 0x75: _reset(0x80); // up (fall-through)
        case 0x72: _reset(0x16); break; // down
        case 0x6b: _reset(0x80); // left (fall-through)
        case 0x74: _reset(0x07); break; // right
        case 0x70: _reset(0x80); // ins (fall-through)
        case 0x71: _reset(0x17); break; // del
        case 0x1f: _super = false; break; // Super/Windows key
        default:
            if (scan < 0x80)
                _reset(_map(scan));
            break;
        }
    } else if (is_ps2_ctrl(scan))
        _ctrl = false;
    else if (scan < 0x80)
        _reset(_map(scan));
}

void kbd::down(uint8_t scan) {

    DBG_EMU("key down: %02x", scan);

    if (scan == 0xe0) {
        _ext = true;
    } else if (_ext) {
        _ext = false;
        switch(scan) {
        case 0x69: _set(0x80); // end (fall-through)
        case 0x6c: _set(0x06); break; // home
        case 0x75: _set(0x80); // up (fall-through)
        case 0x72: _set(0x16); break; // down
        case 0x6b: _set(0x80); // left (fall-through)
        case 0x74: _set(0x07); break; // right
        case 0x70: _set(0x80); // ins (fall-through)
        case 0x71: _set(0x17); break; // del
        case 0x1f: _super = true;  break; // Super/Windows key
        default:
            if (scan < 0x80)
                _set(_map(scan));
        }
    } else if (is_ps2_ctrl(scan)) {
        reset();
        _ctrl = true;
    } else if (scan < 0x80) {
        _set(_map(scan));
    }
}

void kbd::reset() {
    for (int i = sizeof(_rows); i--; )
        _rows[i] = 0;
    _ctrl  = false;
    _shift = false;
    _super = false;
}
